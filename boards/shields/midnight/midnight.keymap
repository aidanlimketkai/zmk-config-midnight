#include <behaviors.dtsi>
#include <dt-bindings/zmk/keys.h>
#include <dt-bindings/zmk/pointing.h>

/ {
    keymap {
        compatible = "zmk,keymap";
        default_layer {
            bindings = <&mkp MCLK>;   /* wheel click = middle click */
        };
    };
};
